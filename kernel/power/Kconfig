## kernel/power/Kconfig
```kconfig
config PM
	bool "Power Management support"
	depends on !IA64_HP_SIM
	---help---
	  "Power Management" means that parts of your computer are shut
	  off or put into a power conserving "sleep" mode if they are not
	  being used.  There are two competing standards for doing this: APM
	  and ACPI.  If you want to use either one, say Y here and then also
	  to the requisite support below.

	  Power Management is most important for battery powered laptop
	  computers; if you have a laptop, check out the Linux Laptop home
	  page on the WWW at <http://www.linux-on-laptops.com/> or
	  Tuxmobil - Linux on Mobile Computers at <http://www.tuxmobil.org/>
	  and the Battery Powered Linux mini-HOWTO, available from
	  <http://www.tldp.org/docs.html#howto>.

	  Note that, even if you say N here, Linux on the x86 architecture
	  will issue the hlt instruction if nothing is to be done, thereby
	  sending the processor to sleep and saving power.

config PM_LEGACY
	bool "Legacy Power Management API (DEPRECATED)"
	depends on PM
	default n
	---help---
	   Support for pm_register() and friends.  This old API is obsoleted
	   by the driver model.

	   If unsure, say N.

config PM_DEBUG
	bool "Power Management Debug Support"
	depends on PM
	---help---
	This option enables various debugging support in the Power Management
	code. This is helpful when debugging and reporting PM bugs, like
	suspend support.

config PM_VERBOSE
	bool "Verbose Power Management debugging"
	depends on PM_DEBUG
	default n
	---help---
	This option enables verbose messages from the Power Management code.

config DISABLE_CONSOLE_SUSPEND
	bool "Keep console(s) enabled during suspend/resume (DANGEROUS)"
	depends on PM_DEBUG && PM_SLEEP
	default n
	---help---
	This option turns off the console suspend mechanism that prevents
	debug messages from reaching the console during the suspend/resume
	operations.  This may be helpful when debugging device drivers'
	suspend/resume routines, but may itself lead to problems, for example
	if netconsole is used.

config PRINTK_NOSAVE
	depends on PM && PM_DEBUG
	bool "Preserve printk data from boot kernel when resuming."
	default n
	---help---
	This option gives printk data and the associated variables the
	attribute __nosave, which means that they will not be saved as
	part of the image. The net effect is that after resuming, your
	dmesg will show the messages from prior to the atomic restore,
	instead of the messages from the resumed kernel. This may be
	useful for debugging hibernation.

config PM_TRACE
	bool "Suspend/resume event tracing"
	depends on PM_DEBUG && X86 && PM_SLEEP && EXPERIMENTAL
	default n
	---help---
	This enables some cheesy code to save the last PM event point in the
	RTC across reboots, so that you can debug a machine that just hangs
	during suspend (or more commonly, during resume).

	To use this debugging feature you should attempt to suspend the machine,
	then reboot it, then run

		dmesg -s 1000000 | grep 'hash matches'

	CAUTION: this option will cause your machine's real-time clock to be
	set to an invalid time after a resume.

config SUSPEND_SMP_POSSIBLE
	bool
	depends on (X86 && !X86_VOYAGER) || (PPC64 && (PPC_PSERIES || PPC_PMAC))
	depends on SMP
	default y

config SUSPEND_SMP
	bool
	depends on SUSPEND_SMP_POSSIBLE && PM_SLEEP
	select HOTPLUG_CPU
	default y

config PM_SLEEP
	bool
	depends on SUSPEND || HIBERNATION
	default y

config SUSPEND
	bool "Suspend to RAM and standby"
	depends on PM
	depends on !SMP || SUSPEND_SMP_POSSIBLE
	default y
	---help---
	  Allow the system to enter sleep states in which main memory is
	  powered and thus its contents are preserved, such as the
	  suspend-to-RAM state (i.e. the ACPI S3 state).

config HIBERNATION
	bool "Hibernation (aka 'suspend to disk')"
	depends on PM && SWAP
	depends on ((X86 || PPC64_SWSUSP || FRV || PPC32) && !SMP) || SUSPEND_SMP_POSSIBLE
	---help---
	  Enable the suspend to disk (STD) functionality, which is usually
	  called "hibernation" in user interfaces.  STD checkpoints the
	  system and powers it off; and restores that checkpoint on reboot.

	  You can suspend your machine with 'echo disk > /sys/power/state'.
	  Alternatively, you can use the additional userland tools available
	  from <http://suspend.sf.net>.

	  In principle it does not require ACPI or APM, although for example
	  ACPI will be used for the final steps when it is available.  One
	  of the reasons to use software suspend is that the firmware hooks
	  for suspend states like suspend-to-RAM (STR) often don't work very
	  well with Linux.

	  It creates an image which is saved in your active swap. Upon the next
	  boot, pass the 'resume=/dev/swappartition' argument to the kernel to
	  have it detect the saved image, restore memory state from it, and
	  continue to run as before. If you do not want the previous state to
	  be reloaded, then use the 'noresume' kernel command line argument.
	  Note, however, that fsck will be run on your filesystems and you will
	  need to run mkswap against the swap partition used for the suspend.

	  It also works with swap files to a limited extent (for details see
	  <file:Documentation/power/swsusp-and-swap-files.txt>).

	  Right now you may boot without resuming and resume later but in the
	  meantime you cannot use the swap partition(s)/file(s) involved in
	  suspending.  Also in this case you must not use the filesystems
	  that were mounted before the suspend.  In particular, you MUST NOT
	  MOUNT any journaled filesystems mounted before the suspend or they
	  will get corrupted in a nasty way.

	  For more information take a look at <file:Documentation/power/swsusp.txt>.

config PM_STD_PARTITION
	string "Default resume partition"
	depends on HIBERNATION
	default ""
	---help---
	  The default resume partition is the partition that the suspend-
	  to-disk implementation will look for a suspended disk image. 

	  The partition specified here will be different for almost every user. 
	  It should be a valid swap partition (at least for now) that is turned
	  on before suspending. 

	  The partition specified can be overridden by specifying:

		resume=/dev/<other device> 

	  which will set the resume partition to the device specified. 

	  Note there is currently not a way to specify which device to save the
	  suspended image to. It will simply pick the first available swap 
	  device.

menuconfig TOI_CORE
	tristate "Enhanced Hibernation (TuxOnIce)"
	depends on HIBERNATION
	default y
	---help---
	  TuxOnIce is the 'new and improved' suspend support.
	  
	  See the TuxOnIce home page (tuxonice.net)
	  for FAQs, HOWTOs and other documentation.

	comment "Image Storage (you need at least one allocator)"
		depends on TOI_CORE
	
	config TOI_FILE
		tristate "File Allocator"
		depends on TOI_CORE
		default y
		---help---
		  This option enables support for storing an image in a
		  simple file. This should be possible, but we're still
		  testing it.

	config TOI_SWAP
		tristate "Swap Allocator"
		depends on TOI_CORE && SWAP
		default y
		---help---
		  This option enables support for storing an image in your
		  swap space.

	comment "General Options"
		depends on TOI_CORE

	config TOI_CRYPTO
		tristate "Compression support"
		depends on TOI_CORE && CRYPTO
		default y
		---help---
		  This option adds support for using cryptoapi compression
		  algorithms. Compression is particularly useful as
		  the LZF support that comes with the TuxOnIce patch can double
		  your suspend and resume speed.

		  You probably want this, so say Y here.

	comment "No compression support available without Cryptoapi support."
		depends on TOI_CORE && !CRYPTO

	config TOI_USERUI
		tristate "Userspace User Interface support"
		depends on TOI_CORE && NET && (VT || SERIAL_CONSOLE)
		default y
		---help---
		  This option enabled support for a userspace based user interface
		  to TuxOnIce, which allows you to have a nice display while suspending
		  and resuming, and also enables features such as pressing escape to
		  cancel a cycle or interactive debugging.

	config TOI_USERUI_DEFAULT_PATH
		string "Default userui program location"
		default "/usr/local/sbin/tuxonice_fbsplash"
		depends on TOI_USERUI
		---help---
		  This entry allows you to specify a default path to the userui binary.

	config TOI_KEEP_IMAGE
		bool "Allow Keep Image Mode"
		depends on TOI_CORE
		---help---
		  This option allows you to keep and image and reuse it. It is intended
		  __ONLY__ for use with systems where all filesystems are mounted read-
		  only (kiosks, for example). To use it, compile this option in and boot
		  normally. Set the KEEP_IMAGE flag in /sys/power/tuxonice and suspend.
		  When you resume, the image will not be removed. You will be unable to turn
		  off swap partitions (assuming you are using the swap allocator), but future
		  suspends simply do a power-down. The image can be updated using the
		  kernel command line parameter suspend_act= to turn off the keep image
		  bit. Keep image mode is a little less user friendly on purpose - it
		  should not be used without thought!

	config TOI_REPLACE_SWSUSP
		bool "Replace swsusp by default"
		default y
		depends on TOI_CORE
		---help---
		  TuxOnIce can replace swsusp. This option makes that the default state,
		  requiring you to echo 0 > /sys/power/tuxonice/replace_swsusp if you want
		  to use the vanilla kernel functionality. Note that your initrd/ramfs will
		  need to do this before trying to resume, too.
		  With overriding swsusp enabled, TuxOnIce will use both the resume= and
		  noresume commandline options _and_ the resume= and noresume ones (for
		  compatibility). resume= takes precedence over resume=. Echoing disk 
		  to /sys/power/state will start a TuxOnIce cycle. If resume= doesn't
		  specify an allocator and both the swap and file allocators are compiled in,
		  the swap allocator will be used by default.

	config TOI_CLUSTER
		tristate "Cluster support"
		default n
		depends on TOI_CORE && NET && BROKEN
		---help---
		  Support for linking multiple machines in a cluster so that they suspend
		  and resume together.

	config TOI_DEFAULT_CLUSTER_MASTER
		string "Default cluster master address/port"
		depends on TOI_CLUSTER
		---help---
		  If this machine will be the master, simply enter a port on which to
		  listen for slaves.
		  If this machine will be a slave, enter the ip address and port on
		  which the master listens with a colon separating them.
		  If no value is set here, cluster support will be disabled by default.

	config TOI_CHECKSUM
		bool "Checksum pageset2"
		depends on TOI_CORE
		select CRYPTO
		select CRYPTO_ALGAPI
		select CRYPTO_MD5
		---help---
		  Adds support for checksumming pageset2 pages, to ensure you really get an
		  atomic copy. Should not normally be needed, but here for verification and
		  diagnostic purposes.

	config TOI_DEFAULT_WAIT
		int "Default waiting time for emergency boot messages"
		default "25"
		range -1 32768
		depends on TOI_CORE
		help
		  TuxOnIce can display warnings very early in the process of resuming,
		  if (for example) it appears that you have booted a kernel that doesn't
		  match an image on disk. It can then give you the opportunity to either
		  continue booting that kernel, or reboot the machine. This option can be
		  used to control how long to wait in such circumstances. -1 means wait
		  forever. 0 means don't wait at all (do the default action, which will
		  generally be to continue booting and remove the image). Values of 1 or
		  more indicate a number of seconds (up to 255) to wait before doing the
		  default.

config TOI_USERUI_EXPORTS
	bool
	depends on TOI_USERUI=m
	default y

config TOI_SWAP_EXPORTS
	bool
	depends on TOI_SWAP=m
	default y

config TOI_FILE_EXPORTS
	bool
	depends on TOI_FILE=m
	default y

config TOI_CRYPTO_EXPORTS
	bool
	depends on TOI_CRYPTO=m
	default y

config TOI_CORE_EXPORTS
	bool
	depends on TOI_CORE=m
	default y

config TOI_EXPORTS
	bool
	depends on TOI_SWAP_EXPORTS || TOI_FILE_EXPORTS || \
		TOI_CRYPTO_EXPORTS || TOI_CLUSTER=m || \
		TOI_USERUI_EXPORTS
	default y

config TOI
	bool
	depends on TOI_CORE!=n
	default y

config APM_EMULATION
	tristate "Advanced Power Management Emulation"
	depends on PM && SYS_SUPPORTS_APM_EMULATION
	help
	  APM is a BIOS specification for saving power using several different
	  techniques. This is mostly useful for battery powered laptops with
	  APM compliant BIOSes. If you say Y here, the system time will be
	  reset after a RESUME operation, the /proc/apm device will provide
	  battery status information, and user-space programs will receive
	  notification of APM "events" (e.g. battery status change).

	  In order to use APM, you will need supporting software. For location
	  and more information, read <file:Documentation/pm.txt> and the
	  Battery Powered Linux mini-HOWTO, available from
	  <http://www.tldp.org/docs.html#howto>.

	  This driver does not spin down disk drives (see the hdparm(8)
	  manpage ("man 8 hdparm") for that), and it doesn't turn off
	  VESA-compliant "green" monitors.

	  Generally, if you don't have a battery in your machine, there isn't
	  much point in using this driver and you should say N. If you get
	  random kernel OOPSes or reboots that don't seem to be related to
	  anything, try disabling/enabling this option (or disabling/enabling
	  APM in your BIOS).
```
